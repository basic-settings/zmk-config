## config/boards/shields/claw/Kconfig.defconfig
```kconfig
config ZMK_BATTERY_REPORT_INTERVAL
	default	600

config ZMK_SLEEP
	default y

config ZMK_IDLE_SLEEP_TIMEOUT
	default 900000

if SHIELD_CLAW_LEFT

config ZMK_KEYBOARD_NAME
	default "Claw"

config ZMK_SPLIT_ROLE_CENTRAL
	default y

endif

if SHIELD_CLAW_LEFT || SHIELD_CLAW_RIGHT

config ZMK_SPLIT
	default y

endif
```
